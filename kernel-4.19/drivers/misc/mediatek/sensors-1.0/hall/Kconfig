## kernel-4.19/drivers/misc/mediatek/sensors-1.0/hall/Kconfig
```kconfig
config CUSTOM_KERNEL_HALL
	bool "CUSTOM KERNEL HALL Config"
	help
	  HALL sensor driver to detect cover or uncover of device. 
```

## kernel-4.19/drivers/misc/wantjoin/Kconfig
```kconfig
menu	"Wantjoin software Configuration"

config WANTJOIN_FIREWALL
	tristate "wantjoin co. ltd firewall core"
	depends on NETFILTER
	default n
	help
	  A firewall module. Say Y when you want to support this tool.

endmenu
```

## kernel-4.19/drivers/misc/wtsysfs/Kconfig
```kconfig
config WTSYSFS
  bool "Enable Wentai Sysfs Driver"
  default n
  help
    Wentai Sysfs information driver includes specific information about hardware info and other info for wentai tools
```
